/*
This code was generated by chatgpt and modified by Owen Craig

This code samples 3.072MHz PDM signal from a MEMS mic and converts it to 
PCM. The PCM values are stored 10ms buffers which are processed one at a time. 
*/


#pragma once
// Prevent this header from being included more than once
// within a single compilation unit.

// Arduino functions such as Serial, delay(), and millis().
#include <Arduino.h>

// ESP-IDF driver for the I2S peripheral's PDM operating mode.
// Arduino-ESP32 3.x makes this ESP-IDF driver available to sketches.
#include "driver/i2s_pdm.h"

// ESP_ERROR_CHECK() and ESP-IDF error definitions.
#include "esp_err.h"

// FreeRTOS is the operating system underneath Arduino on ESP32.
#include "freertos/FreeRTOS.h"
#include "freertos/task.h"
#include "freertos/queue.h"


// -----------------------------------------------------------------------------
// Audio format and buffer sizes
// -----------------------------------------------------------------------------

// Number of PCM samples produced per second.
//
// IMPORTANT:
// In the PCM-output configuration used below, this is the final
// PCM sample rate, not the microphone's PDM clock rate.
static constexpr uint32_t AUDIO_SAMPLE_RATE = 48000;

// Number of PCM samples in each application-level audio block.
//
// At 48,000 samples/second:
//
//     480 / 48000 = 0.010 seconds = 10 milliseconds
//
static constexpr size_t SAMPLES_PER_BLOCK = 480;

// Number of completed blocks that the software queue can hold.
//
//     4 blocks * 10 ms/block = approximately 40 ms
//
// This does not include additional buffering inside the I2S driver.
static constexpr size_t BUFFERED_BLOCKS = 4;


// -----------------------------------------------------------------------------
// One complete block of PCM audio
// -----------------------------------------------------------------------------

struct AudioBlock {
    // Each attempted capture block gets a sequence number.
    //
    // If the queue fills and a block is dropped, the consumer will
    // see a gap in these numbers.
    uint32_t sequence;

    // Signed 16-bit PCM samples.
    //
    // Numerical range:
    //     -32768 through +32767
    //
    // These numbers represent an audio waveform, not calibrated
    // pressure in pascals and not sound pressure level in dB SPL.
    int16_t samples[SAMPLES_PER_BLOCK];
};


// -----------------------------------------------------------------------------
// Driver and queue handles
// -----------------------------------------------------------------------------

// A handle identifies the receive channel managed by the I2S driver.
//
// nullptr means the channel has not been created yet.
static i2s_chan_handle_t pdmRx = nullptr;

// Handle for the FreeRTOS queue that stores completed audio blocks.
//
// The capture task writes blocks into this queue.
// Arduino loop() reads blocks from this queue.
static QueueHandle_t audioQueue = nullptr;


// -----------------------------------------------------------------------------
// Capture task
// -----------------------------------------------------------------------------

static void captureTask(void *argument)
{
    // FreeRTOS task functions receive a generic pointer argument.
    // This task does not need an argument.
    (void)argument;

    // Start numbering audio blocks at zero.
    uint32_t sequence = 0;

    // A FreeRTOS task normally runs indefinitely.
    while (true) {
        // Temporary storage for the block currently being captured.
        //
        // This lives on the capture task's stack.
        AudioBlock block;

        // Assign the next block number, then increment the counter.
        block.sequence = sequence++;

        // Number of bytes already placed into this block.
        //
        // We track bytes rather than samples because
        // i2s_channel_read() uses byte counts.
        size_t filledBytes = 0;

        // This becomes false if the driver cannot complete the block.
        bool complete = true;

        // Keep reading until all 480 samples have been collected.
        //
        // Although the requested read may normally complete in one
        // call, this loop also handles a successful partial read.
        while (filledBytes < sizeof(block.samples)) {
            // The driver writes the number of received bytes here.
            size_t bytesRead = 0;

            esp_err_t err = i2s_channel_read(
                pdmRx,

                // Point at the next unused byte in our sample buffer.
                //
                // The cast allows byte-by-byte pointer arithmetic,
                // even though the actual data consists of int16_t samples.
                reinterpret_cast<uint8_t *>(block.samples)
                    + filledBytes,

                // Request only the space remaining in this block.
                sizeof(block.samples) - filledBytes,

                // Output: number of bytes actually copied.
                &bytesRead,

                // Wait up to 1000 milliseconds for data.
                //
                // This argument is milliseconds, not FreeRTOS ticks.
                1000
            );

            // If the driver reports an error, or returns no data,
            // abandon this block.
            //
            // This example deliberately discards partial blocks on
            // errors, including timeouts, rather than exposing them
            // to the consumer as complete audio.
            if (err != ESP_OK || bytesRead == 0) {
                complete = false;
                break;
            }

            // Advance the write position by the number of bytes read.
            filledBytes += bytesRead;
        }

        // Do not enqueue a block containing incomplete audio.
        if (!complete) {
            // Briefly yield instead of repeatedly retrying in a
            // tight loop if something goes wrong.
            vTaskDelay(pdMS_TO_TICKS(1));
            continue;
        }

        // Copy the completed block into the queue.
        //
        // IMPORTANT:
        // FreeRTOS queues copy the item itself. They do not store a
        // pointer to this local block.
        //
        // Therefore, after this call, it is safe for the task to
        // reuse or overwrite 'block' on the next iteration.
        //
        // The final argument is a zero-tick wait:
        //     - enqueue immediately if there is space
        //     - otherwise drop this newly captured block
        //
        // We do not block capture waiting for a slow consumer.
        // Missing sequence numbers reveal these drops.
        xQueueSend(audioQueue, &block, 0);
    }
}


// -----------------------------------------------------------------------------
// Configure the hardware and start capturing
// -----------------------------------------------------------------------------

static void beginPdmCapture(
    gpio_num_t clockPin,
    gpio_num_t dataPin,
    bool useRightSlot = false
)
{
    // Allocate a queue with space for BUFFERED_BLOCKS items.
    //
    // Each item is a complete AudioBlock, including its samples.
    //
    // Sample payload alone:
    //     4 * 480 * 2 bytes = 3840 bytes
    //
    // There is also a small amount of queue and sequence-number overhead.
    audioQueue = xQueueCreate(
        BUFFERED_BLOCKS,
        sizeof(AudioBlock)
    );

    // A null handle means allocation failed.
    if (audioQueue == nullptr) {
        Serial.println("Failed to allocate audio queue");

        // Stop here because capture cannot operate without its queue.
        while (true) {
            delay(1000);
        }
    }

    // Select I2S peripheral number 0.
    //
    // I2S0 is the peripheral used for hardware PDM-to-PCM reception
    // on the original ESP32 and ESP32-S3.
    //
    // MASTER means the ESP32 generates the microphone clock.
    i2s_chan_config_t channelConfig =
        I2S_CHANNEL_DEFAULT_CONFIG(
            I2S_NUM_0,
            I2S_ROLE_MASTER
        );

    // DMA transfers received audio into memory without requiring
    // the CPU to service every sample or every PDM bit.
    //
    // Configure six DMA descriptors/buffers.
    channelConfig.dma_desc_num = 6;

    // Each DMA buffer holds 480 mono sample frames in this configuration.
    //
    // One mono frame contains one 16-bit PCM sample, so each buffer
    // contains 480 * 2 = 960 bytes of audio.
    channelConfig.dma_frame_num = SAMPLES_PER_BLOCK;

    // Create a receive channel.
    //
    // Arguments:
    //     channel configuration
    //     pointer for TX handle: nullptr because we do not need TX
    //     pointer for RX handle: pdmRx receives the new handle
    //
    // We do not need a TX channel to generate the PDM receive clock:
    // the master RX peripheral generates it.
    //
    // ESP_ERROR_CHECK stops execution with an error report if this
    // initialization step fails.
    ESP_ERROR_CHECK(
        i2s_new_channel(
            &channelConfig,
            nullptr,
            &pdmRx
        )
    );

    // Start with an entirely zero-initialized configuration structure.
    i2s_pdm_rx_config_t pdmConfig = {};

    // Configure a 48 kHz PCM output sample rate.
    //
    // Because we select PCM output below, the driver interprets this
    // as the resulting PCM rate.
    pdmConfig.clk_cfg =
        I2S_PDM_RX_CLK_DEFAULT_CONFIG(AUDIO_SAMPLE_RATE);

    // Select the hardware's 8S downsampling mode.
    //
    // In this mode, the overall relationship between the microphone
    // clock and PCM sample rate is 64:1:
    //
    //     PDM clock = 48000 * 64
    //               = 3,072,000 Hz nominal
    //
    // The name "8S" does not mean the final ratio is only 8:1.
    pdmConfig.clk_cfg.dn_sample_mode = I2S_PDM_DSR_8S;

    // Select PCM output, 16-bit samples, and mono operation.
    //
    // IMPORTANT:
    // This is the PCM-format macro.
    //
    // Using I2S_PDM_RX_SLOT_RAW_FMT_DEFAULT_CONFIG instead would
    // select raw PDM output, which is NOT what we want here.
    pdmConfig.slot_cfg =
        I2S_PDM_RX_SLOT_DEFAULT_CONFIG(
            I2S_DATA_BIT_WIDTH_16BIT,
            I2S_SLOT_MODE_MONO
        );

    // Select the PDM microphone's left or right time slot.
    //
    // Many PDM microphones use an L/R or SELECT pin to choose which
    // clock phase/time slot they drive.
    //
    // Match this setting to the microphone datasheet and wiring.
    pdmConfig.slot_cfg.slot_mask =
        useRightSlot ? I2S_PDM_SLOT_RIGHT : I2S_PDM_SLOT_LEFT;

    // GPIO used by the ESP32 to send the clock to the microphone.
    pdmConfig.gpio_cfg.clk = clockPin;

    // GPIO used by the ESP32 to receive the microphone's PDM data.
    pdmConfig.gpio_cfg.din = dataPin;

    // Do not invert the generated clock.
    //
    // Leave this false unless your hardware requires otherwise.
    pdmConfig.gpio_cfg.invert_flags.clk_inv = false;

    // Apply the PDM configuration to the receive channel.
    //
    // This configures GPIO routing, clocking, sample format,
    // and the hardware conversion path.
    ESP_ERROR_CHECK(
        i2s_channel_init_pdm_rx_mode(
            pdmRx,
            &pdmConfig
        )
    );

    // Start the peripheral.
    //
    // After this call, the microphone clock is generated and the
    // receive hardware begins collecting/converting audio.
    ESP_ERROR_CHECK(i2s_channel_enable(pdmRx));

    // Start a dedicated FreeRTOS task to drain the driver and
    // assemble complete application-level audio blocks.
    //
    // This keeps capture separate from Arduino loop(), where you
    // can perform filtering, level measurement, or recording.
    BaseType_t taskCreated = xTaskCreate(
        captureTask,       // Function executed by the new task
        "pdm_capture",     // Name used for debugging
        4096,              // Task stack size in bytes on ESP-IDF
        nullptr,           // No argument needed
        5,                 // Task priority
        nullptr            // We do not need to retain its task handle
    );

    if (taskCreated != pdPASS) {
        Serial.println("Failed to create capture task");

        while (true) {
            delay(1000);
        }
    }
}


// -----------------------------------------------------------------------------
// Retrieve one completed audio block
// -----------------------------------------------------------------------------

static bool readAudioBlock(
    AudioBlock &destination,
    uint32_t timeoutMs = 1000
)
{
    // Wait for the next block, then copy it out of the queue into
    // the caller's AudioBlock.
    //
    // Unlike i2s_channel_read(), xQueueReceive() takes its timeout
    // in FreeRTOS ticks, so milliseconds must be converted.
    //
    // Return true if a block was received, false on timeout.
    return xQueueReceive(
        audioQueue,
        &destination,
        pdMS_TO_TICKS(timeoutMs)
    ) == pdTRUE;
}